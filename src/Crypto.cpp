#include <Arduino.h>
#include <string.h>
#include "Crypto.h"

extern "C" {
#include "aes.h"
}

// ============================================================
//  SHA-256
// ============================================================
static const uint32_t K256[64] = {
  0x428a2f98,0x71374491,0xb5c0fbcf,0xe9b5dba5,0x3956c25b,0x59f111f1,0x923f82a4,0xab1c5ed5,
  0xd807aa98,0x12835b01,0x243185be,0x550c7dc3,0x72be5d74,0x80deb1fe,0x9bdc06a7,0xc19bf174,
  0xe49b69c1,0xefbe4786,0x0fc19dc6,0x240ca1cc,0x2de92c6f,0x4a7484aa,0x5cb0a9dc,0x76f988da,
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  0x748f82ee,0x78a5636f,0x84c87814,0x8cc70208,0x90befffa,0xa4506ceb,0xbef9a3f7,0xc67178f2
};
#define ROR(x, n) (((x) >> (n)) | ((x) << (32 - (n))))

static void sha256Block(uint32_t h[8], const uint8_t *p) {
  uint32_t w[64];
  for (int i = 0; i < 16; i++)
    w[i] = ((uint32_t)p[4*i] << 24) | ((uint32_t)p[4*i+1] << 16) | ((uint32_t)p[4*i+2] << 8) | p[4*i+3];
  for (int i = 16; i < 64; i++) {
    uint32_t s0 = ROR(w[i-15], 7) ^ ROR(w[i-15], 18) ^ (w[i-15] >> 3);
    uint32_t s1 = ROR(w[i-2], 17) ^ ROR(w[i-2], 19) ^ (w[i-2] >> 10);
    w[i] = w[i-16] + s0 + w[i-7] + s1;
  }
  uint32_t a = h[0], b = h[1], c = h[2], d = h[3], e = h[4], f = h[5], g = h[6], hh = h[7];
  for (int i = 0; i < 64; i++) {
    uint32_t S1 = ROR(e, 6) ^ ROR(e, 11) ^ ROR(e, 25);
    uint32_t ch = (e & f) ^ (~e & g);
    uint32_t t1 = hh + S1 + ch + K256[i] + w[i];
    uint32_t S0 = ROR(a, 2) ^ ROR(a, 13) ^ ROR(a, 22);
    uint32_t mj = (a & b) ^ (a & c) ^ (b & c);
    uint32_t t2 = S0 + mj;
    hh = g; g = f; f = e; e = d + t1; d = c; c = b; b = a; a = t1 + t2;
  }
  h[0] += a; h[1] += b; h[2] += c; h[3] += d; h[4] += e; h[5] += f; h[6] += g; h[7] += hh;
}

void Crypto_sha256(const uint8_t *data, size_t len, uint8_t out[32]) {
  uint32_t h[8] = { 0x6a09e667,0xbb67ae85,0x3c6ef372,0xa54ff53a,0x510e527f,0x9b05688c,0x1f83d9ab,0x5be0cd19 };
  size_t i = 0;
  for (; i + 64 <= len; i += 64) sha256Block(h, data + i);
  uint8_t tail[128];
  size_t rem = len - i;
  memcpy(tail, data + i, rem);
  tail[rem++] = 0x80;
  size_t total = (rem + 8 <= 64) ? 64 : 128;
  memset(tail + rem, 0, total - rem);
  uint64_t bits = (uint64_t)len * 8;
  for (int k = 0; k < 8; k++) tail[total - 1 - k] = (uint8_t)(bits >> (8 * k));
  sha256Block(h, tail);
  if (total == 128) sha256Block(h, tail + 64);
  for (int k = 0; k < 8; k++) {
    out[4*k] = h[k] >> 24; out[4*k+1] = h[k] >> 16; out[4*k+2] = h[k] >> 8; out[4*k+3] = h[k];
  }
}

// ============================================================
//  X25519 (TweetNaCl, dominio publico). Aritmetica de campo en 16 "limbs" de 16 bits con enteros de 64 bits.
// ============================================================
typedef int64_t gf[16];
static const gf C121665 = { 0xDB41, 1 };

static void car25519(gf o) {
  for (int i = 0; i < 16; i++) {
    o[i] += (1LL << 16);
    int64_t c = o[i] >> 16;
    o[(i + 1) * (i < 15)] += c - 1 + 37 * (c - 1) * (i == 15);
    o[i] -= c << 16;
  }
}
static void sel25519(gf p, gf q, int64_t b) {
  int64_t c = ~(b - 1);
  for (int i = 0; i < 16; i++) { int64_t t = c & (p[i] ^ q[i]); p[i] ^= t; q[i] ^= t; }
}
static void pack25519(uint8_t *o, const gf n) {
  gf m, t;
  for (int i = 0; i < 16; i++) t[i] = n[i];
  car25519(t); car25519(t); car25519(t);
  for (int j = 0; j < 2; j++) {
    m[0] = t[0] - 0xffed;
    for (int i = 1; i < 15; i++) { m[i] = t[i] - 0xffff - ((m[i-1] >> 16) & 1); m[i-1] &= 0xffff; }
    m[15] = t[15] - 0x7fff - ((m[14] >> 16) & 1);
    int64_t b = (m[15] >> 16) & 1;
    m[14] &= 0xffff;
    sel25519(t, m, 1 - b);
  }
  for (int i = 0; i < 16; i++) { o[2*i] = t[i] & 0xff; o[2*i+1] = t[i] >> 8; }
}
static void unpack25519(gf o, const uint8_t *n) {
  for (int i = 0; i < 16; i++) o[i] = n[2*i] + ((int64_t)n[2*i+1] << 8);
  o[15] &= 0x7fff;
}
static void fA(gf o, const gf a, const gf b) { for (int i = 0; i < 16; i++) o[i] = a[i] + b[i]; }
static void fZ(gf o, const gf a, const gf b) { for (int i = 0; i < 16; i++) o[i] = a[i] - b[i]; }
static void fM(gf o, const gf a, const gf b) {
  int64_t t[31];
  for (int i = 0; i < 31; i++) t[i] = 0;
  for (int i = 0; i < 16; i++) for (int j = 0; j < 16; j++) t[i+j] += a[i] * b[j];
  for (int i = 0; i < 15; i++) t[i] += 38 * t[i+16];
  for (int i = 0; i < 16; i++) o[i] = t[i];
  car25519(o); car25519(o);
}
static void fS(gf o, const gf a) { fM(o, a, a); }
static void inv25519(gf o, const gf in) {
  gf c;
  for (int a = 0; a < 16; a++) c[a] = in[a];
  for (int a = 253; a >= 0; a--) { fS(c, c); if (a != 2 && a != 4) fM(c, c, in); }
  for (int a = 0; a < 16; a++) o[a] = c[a];
}

void Crypto_x25519(uint8_t out[32], const uint8_t scalar[32], const uint8_t point[32]) {
  uint8_t z[32];
  int64_t x[80];
  gf a, b, c, d, e, f;
  for (int i = 0; i < 31; i++) z[i] = scalar[i];
  z[31] = (scalar[31] & 127) | 64;
  z[0] &= 248;
  unpack25519(x, point);
  for (int i = 0; i < 16; i++) { b[i] = x[i]; d[i] = a[i] = c[i] = 0; }
  a[0] = d[0] = 1;
  for (int i = 254; i >= 0; --i) {
    int64_t r = (z[i >> 3] >> (i & 7)) & 1;
    sel25519(a, b, r); sel25519(c, d, r);
    fA(e, a, c); fZ(a, a, c); fA(c, b, d); fZ(b, b, d);
    fS(d, e); fS(f, a); fM(a, c, a); fM(c, b, e);
    fA(e, a, c); fZ(a, a, c); fS(b, a); fZ(c, d, f);
    fM(a, c, C121665); fA(a, a, d); fM(c, c, a); fM(a, d, f);
    fM(d, b, x); fS(b, e);
    sel25519(a, b, r); sel25519(c, d, r);
    yield();                                   // ~4 ms por vuelta en el ESP8266: no dejar que salte el watchdog
  }
  for (int i = 0; i < 16; i++) { x[i+16] = a[i]; x[i+32] = c[i]; x[i+48] = b[i]; x[i+64] = d[i]; }
  inv25519(x + 32, x + 32);
  fM(x + 16, x + 16, x + 32);
  pack25519(out, x + 16);
}

void Crypto_x25519Base(uint8_t out[32], const uint8_t scalar[32]) {
  uint8_t base[32] = { 9 };
  Crypto_x25519(out, scalar, base);
}

// ============================================================
//  AES-CMAC (RFC 4493)
// ============================================================
static void aesEnc(const uint8_t key[16], uint8_t blk[16]) {
  struct AES_ctx ctx;
  AES_init_ctx(&ctx, key);
  AES_ECB_encrypt(&ctx, blk);
}
static void dbl(uint8_t b[16]) {
  uint8_t carry = b[0] >> 7;
  for (int i = 0; i < 15; i++) b[i] = (b[i] << 1) | (b[i+1] >> 7);
  b[15] = (b[15] << 1) ^ (carry ? 0x87 : 0);
}

void Crypto_aesCmac(const uint8_t key[16], const uint8_t *msg, size_t len, uint8_t out[16]) {
  uint8_t k1[16] = {0};
  aesEnc(key, k1);
  dbl(k1);
  uint8_t k2[16]; memcpy(k2, k1, 16); dbl(k2);
  size_t n = (len + 15) / 16;
  bool complete = (len > 0 && len % 16 == 0);
  if (n == 0) n = 1;
  uint8_t x[16] = {0}, last[16];
  for (size_t i = 0; i + 1 < n; i++) {
    for (int j = 0; j < 16; j++) x[j] ^= msg[16*i + j];
    aesEnc(key, x);
  }
  size_t off = 16 * (n - 1), rem = len - off;
  if (complete) { for (int j = 0; j < 16; j++) last[j] = msg[off + j] ^ k1[j]; }
  else {
    memset(last, 0, 16);
    memcpy(last, msg + off, rem);
    last[rem] = 0x80;
    for (int j = 0; j < 16; j++) last[j] ^= k2[j];
  }
  for (int j = 0; j < 16; j++) x[j] ^= last[j];
  aesEnc(key, x);
  memcpy(out, x, 16);
}

bool Crypto_equal(const uint8_t *a, const uint8_t *b, size_t n) {
  uint8_t d = 0;
  for (size_t i = 0; i < n; i++) d |= a[i] ^ b[i];
  return d == 0;
}

// ============================================================
//  Autotest con vectores oficiales (RFC 7748, RFC 4493, FIPS 180-4), generados con una implementacion de referencia
// ============================================================

static const struct { const char *msg; size_t len; uint8_t h[32]; } SHA_V[] = {
  { "", 0, { 0xe3, 0xb0, 0xc4, 0x42, 0x98, 0xfc, 0x1c, 0x14, 0x9a, 0xfb, 0xf4, 0xc8, 0x99, 0x6f, 0xb9, 0x24, 0x27, 0xae, 0x41, 0xe4, 0x64, 0x9b, 0x93, 0x4c, 0xa4, 0x95, 0x99, 0x1b, 0x78, 0x52, 0xb8, 0x55 } },
  { "\x61\x62\x63", 3, { 0xba, 0x78, 0x16, 0xbf, 0x8f, 0x01, 0xcf, 0xea, 0x41, 0x41, 0x40, 0xde, 0x5d, 0xae, 0x22, 0x23, 0xb0, 0x03, 0x61, 0xa3, 0x96, 0x17, 0x7a, 0x9c, 0xb4, 0x10, 0xff, 0x61, 0xf2, 0x00, 0x15, 0xad } },
  { "\x61\x62\x63\x64\x62\x63\x64\x65\x63\x64\x65\x66\x64\x65\x66\x67\x65\x66\x67\x68\x66\x67\x68\x69\x67\x68\x69\x6a\x68\x69\x6a\x6b\x69\x6a\x6b\x6c\x6a\x6b\x6c\x6d\x6b\x6c\x6d\x6e\x6c\x6d\x6e\x6f\x6d\x6e\x6f\x70\x6e\x6f\x70\x71", 56, { 0x24, 0x8d, 0x6a, 0x61, 0xd2, 0x06, 0x38, 0xb8, 0xe5, 0xc0, 0x26, 0x93, 0x0c, 0x3e, 0x60, 0x39, 0xa3, 0x3c, 0xe4, 0x59, 0x64, 0xff, 0x21, 0x67, 0xf6, 0xec, 0xed, 0xd4, 0x19, 0xdb, 0x06, 0xc1 } },
  { "\x00\x01\x02\x03\x04\x05\x06\x07\x08\x09\x0a\x0b\x0c\x0d\x0e\x0f\x10\x11\x12\x13\x14\x15\x16\x17\x18\x19\x1a\x1b\x1c\x1d\x1e\x1f\x20\x21\x22\x23\x24\x25\x26\x27\x28\x29\x2a\x2b\x2c\x2d\x2e\x2f\x30\x31\x32\x33\x34\x35\x36\x37\x38\x39\x3a\x3b\x3c\x3d\x3e\x3f\x40\x41\x42\x43\x44\x45\x46\x47\x48\x49\x4a\x4b\x4c\x4d\x4e\x4f\x50\x51\x52\x53\x54\x55\x56\x57\x58\x59\x5a\x5b\x5c\x5d\x5e\x5f\x60\x61\x62\x63\x64\x65\x66\x67\x68\x69\x6a\x6b\x6c\x6d\x6e\x6f\x70\x71\x72\x73\x74\x75\x76\x77\x78\x79\x7a\x7b\x7c\x7d\x7e\x7f\x80\x81\x82\x83\x84\x85\x86\x87\x88\x89\x8a\x8b\x8c\x8d\x8e\x8f\x90\x91\x92\x93\x94\x95\x96\x97\x98\x99\x9a\x9b\x9c\x9d\x9e\x9f\xa0\xa1\xa2\xa3\xa4\xa5\xa6\xa7\xa8\xa9\xaa\xab\xac\xad\xae\xaf\xb0\xb1\xb2\xb3\xb4\xb5\xb6\xb7\xb8\xb9\xba\xbb\xbc\xbd\xbe\xbf\xc0\xc1\xc2\xc3\xc4\xc5\xc6\xc7", 200, { 0x19, 0x01, 0xda, 0x1c, 0x9f, 0x69, 0x9b, 0x48, 0xf6, 0xb2, 0x63, 0x6e, 0x65, 0xcb, 0xf7, 0x3a, 0xbf, 0x99, 0xd0, 0x44, 0x1e, 0xf6, 0x7f, 0x5c, 0x54, 0x0a, 0x42, 0xf7, 0x05, 0x1d, 0xec, 0x6f } },
};
static const struct { uint8_t s[32], u[32], r[32]; } X_V[] = {
  { { 0xa5, 0x46, 0xe3, 0x6b, 0xf0, 0x52, 0x7c, 0x9d, 0x3b, 0x16, 0x15, 0x4b, 0x82, 0x46, 0x5e, 0xdd, 0x62, 0x14, 0x4c, 0x0a, 0xc1, 0xfc, 0x5a, 0x18, 0x50, 0x6a, 0x22, 0x44, 0xba, 0x44, 0x9a, 0xc4 },
    { 0xe6, 0xdb, 0x68, 0x67, 0x58, 0x30, 0x30, 0xdb, 0x35, 0x94, 0xc1, 0xa4, 0x24, 0xb1, 0x5f, 0x7c, 0x72, 0x66, 0x24, 0xec, 0x26, 0xb3, 0x35, 0x3b, 0x10, 0xa9, 0x03, 0xa6, 0xd0, 0xab, 0x1c, 0x4c },
    { 0xc3, 0xda, 0x55, 0x37, 0x9d, 0xe9, 0xc6, 0x90, 0x8e, 0x94, 0xea, 0x4d, 0xf2, 0x8d, 0x08, 0x4f, 0x32, 0xec, 0xcf, 0x03, 0x49, 0x1c, 0x71, 0xf7, 0x54, 0xb4, 0x07, 0x55, 0x77, 0xa2, 0x85, 0x52 } },
  { { 0x4b, 0x66, 0xe9, 0xd4, 0xd1, 0xb4, 0x67, 0x3c, 0x5a, 0xd2, 0x26, 0x91, 0x95, 0x7d, 0x6a, 0xf5, 0xc1, 0x1b, 0x64, 0x21, 0xe0, 0xea, 0x01, 0xd4, 0x2c, 0xa4, 0x16, 0x9e, 0x79, 0x18, 0xba, 0x0d },
    { 0xe5, 0x21, 0x0f, 0x12, 0x78, 0x68, 0x11, 0xd3, 0xf4, 0xb7, 0x95, 0x9d, 0x05, 0x38, 0xae, 0x2c, 0x31, 0xdb, 0xe7, 0x10, 0x6f, 0xc0, 0x3c, 0x3e, 0xfc, 0x4c, 0xd5, 0x49, 0xc7, 0x15, 0xa4, 0x93 },
    { 0x95, 0xcb, 0xde, 0x94, 0x76, 0xe8, 0x90, 0x7d, 0x7a, 0xad, 0xe4, 0x5c, 0xb4, 0xb8, 0x73, 0xf8, 0x8b, 0x59, 0x5a, 0x68, 0x79, 0x9f, 0xa1, 0x52, 0xe6, 0xf8, 0xf7, 0x64, 0x7a, 0xac, 0x79, 0x57 } },
};
static const uint8_t DH_A[32] = { 0x77, 0x07, 0x6d, 0x0a, 0x73, 0x18, 0xa5, 0x7d, 0x3c, 0x16, 0xc1, 0x72, 0x51, 0xb2, 0x66, 0x45, 0xdf, 0x4c, 0x2f, 0x87, 0xeb, 0xc0, 0x99, 0x2a, 0xb1, 0x77, 0xfb, 0xa5, 0x1d, 0xb9, 0x2c, 0x2a }, DH_B[32] = { 0x5d, 0xab, 0x08, 0x7e, 0x62, 0x4a, 0x8a, 0x4b, 0x79, 0xe1, 0x7f, 0x8b, 0x83, 0x80, 0x0e, 0xe6, 0x6f, 0x3b, 0xb1, 0x29, 0x26, 0x18, 0xb6, 0xfd, 0x1c, 0x2f, 0x8b, 0x27, 0xff, 0x88, 0xe0, 0xeb }, DH_PA[32] = { 0x85, 0x20, 0xf0, 0x09, 0x89, 0x30, 0xa7, 0x54, 0x74, 0x8b, 0x7d, 0xdc, 0xb4, 0x3e, 0xf7, 0x5a, 0x0d, 0xbf, 0x3a, 0x0d, 0x26, 0x38, 0x1a, 0xf4, 0xeb, 0xa4, 0xa9, 0x8e, 0xaa, 0x9b, 0x4e, 0x6a }, DH_PB[32] = { 0xde, 0x9e, 0xdb, 0x7d, 0x7b, 0x7d, 0xc1, 0xb4, 0xd3, 0x5b, 0x61, 0xc2, 0xec, 0xe4, 0x35, 0x37, 0x3f, 0x83, 0x43, 0xc8, 0x5b, 0x78, 0x67, 0x4d, 0xad, 0xfc, 0x7e, 0x14, 0x6f, 0x88, 0x2b, 0x4f }, DH_S[32] = { 0x4a, 0x5d, 0x9d, 0x5b, 0xa4, 0xce, 0x2d, 0xe1, 0x72, 0x8e, 0x3b, 0xf4, 0x80, 0x35, 0x0f, 0x25, 0xe0, 0x7e, 0x21, 0xc9, 0x47, 0xd1, 0x9e, 0x33, 0x76, 0xf0, 0x9b, 0x3c, 0x1e, 0x16, 0x17, 0x42 };
static const uint8_t CM_KEY[16] = { 0x2b, 0x7e, 0x15, 0x16, 0x28, 0xae, 0xd2, 0xa6, 0xab, 0xf7, 0x15, 0x88, 0x09, 0xcf, 0x4f, 0x3c };
static const uint8_t CM_MSG[64] = { 0x6b, 0xc1, 0xbe, 0xe2, 0x2e, 0x40, 0x9f, 0x96, 0xe9, 0x3d, 0x7e, 0x11, 0x73,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 0x37, 0x10 };
static const struct { size_t len; uint8_t t[16]; } CM_V[] = {
  { 0, { 0xbb, 0x1d, 0x69, 0x29, 0xe9, 0x59, 0x37, 0x28, 0x7f, 0xa3, 0x7d, 0x12, 0x9b, 0x75, 0x67, 0x46 } },
  { 16, { 0x07, 0x0a, 0x16, 0xb4, 0x6b, 0x4d, 0x41, 0x44, 0xf7, 0x9b, 0xdd, 0x9d, 0xd0, 0x4a, 0x28, 0x7c } },
  { 40, { 0xdf, 0xa6, 0x67, 0x47, 0xde, 0x9a, 0xe6, 0x30, 0x30, 0xca, 0x32, 0x61, 0x14, 0x97, 0xc8, 0x27 } },
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  { 48, { 0xc4, 0x7c, 0x4d, 0x9d, 0x64, 0x58, 0x8f, 0x67, 0xfb, 0x9d, 0xe6, 0xfe, 0x74, 0x5d, 0x7f, 0xbf } },
};

bool Crypto_selfTest() {
  uint8_t h[32], o[32], t[16];
  for (size_t i = 0; i < sizeof(SHA_V) / sizeof(SHA_V[0]); i++) {
    Crypto_sha256((const uint8_t *)SHA_V[i].msg, SHA_V[i].len, h);
    if (!Crypto_equal(h, SHA_V[i].h, 32)) return false;
  }
  for (size_t i = 0; i < sizeof(X_V) / sizeof(X_V[0]); i++) {
    Crypto_x25519(o, X_V[i].s, X_V[i].u);
    if (!Crypto_equal(o, X_V[i].r, 32)) return false;
  }
  Crypto_x25519Base(o, DH_A);  if (!Crypto_equal(o, DH_PA, 32)) return false;
  Crypto_x25519Base(o, DH_B);  if (!Crypto_equal(o, DH_PB, 32)) return false;
  Crypto_x25519(o, DH_A, DH_PB); if (!Crypto_equal(o, DH_S, 32)) return false;
  Crypto_x25519(o, DH_B, DH_PA); if (!Crypto_equal(o, DH_S, 32)) return false;
  for (size_t i = 0; i < sizeof(CM_V) / sizeof(CM_V[0]); i++) {
    Crypto_aesCmac(CM_KEY, CM_MSG, CM_V[i].len, t);
    if (!Crypto_equal(t, CM_V[i].t, 16)) return false;
  }
  return true;
}
